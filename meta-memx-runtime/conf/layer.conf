## meta-memx-runtime/conf/layer.conf
```bitbake
# We have a conf and classes directory, add to BBPATH
BBPATH .= ":${LAYERDIR}"

# We have recipes-* directories, add to BBFILES
BBFILES += "${LAYERDIR}/recipes-*/*/*.bb \
            ${LAYERDIR}/recipes-*/*/*.bbappend"

BBFILE_COLLECTIONS += "meta-memx-runtime"
BBFILE_PATTERN_meta-memx-runtime = "^${LAYERDIR}/"
BBFILE_PRIORITY_meta-memx-runtime = "6"

LAYERDEPENDS_meta-memx-runtime = "core"
LAYERSERIES_COMPAT_meta-memx-runtime = "styhead walnascar"
```

## meta-mx3-driver/conf/layer.conf
```bitbake
# We have a conf and classes directory, add to BBPATH
BBPATH .= ":${LAYERDIR}"

# We have recipes-* directories, add to BBFILES
BBFILES += "${LAYERDIR}/recipes-*/*/*.bb \
            ${LAYERDIR}/recipes-*/*/*.bbappend"

BBFILE_COLLECTIONS += "meta-mx3-driver"
BBFILE_PATTERN_meta-mx3-driver = "^${LAYERDIR}/"
BBFILE_PRIORITY_meta-mx3-driver = "6"

LAYERDEPENDS_meta-mx3-driver = "core"
LAYERSERIES_COMPAT_meta-mx3-driver = "styhead walnascar"
```
